## sdkconfig.defaults
```kconfig
CONFIG_ESPTOOLPY_FLASHSIZE="8MB"
CONFIG_ESPTOOLPY_FLASHSIZE_8MB=y
CONFIG_BOOTLOADER_APP_ROLLBACK_ENABLE=y
CONFIG_PARTITION_TABLE_CUSTOM=y
CONFIG_PARTITION_TABLE_CUSTOM_FILENAME="partitions.csv"
CONFIG_PARTITION_TABLE_FILENAME="partitions.csv"
CONFIG_SPIFFS_MAX_PARTITIONS=3
CONFIG_SPIFFS_GUI_DISABLE=y

CONFIG_ESP_WIFI_STATIC_RX_BUFFER_NUM=10
CONFIG_ESP_WIFI_DYNAMIC_RX_BUFFER_NUM=32
CONFIG_ESP_WIFI_DYNAMIC_TX_BUFFER_NUM=32
CONFIG_ESP_WIFI_AMPDU_TX_ENABLED=y
CONFIG_ESP_WIFI_AMPDU_RX_ENABLED=y

CONFIG_MQTT_PROTOCOL_311=y
CONFIG_MQTT_TRANSPORT_MQTT_OVER_SSL=y
CONFIG_MQTT_USE_DEFAULT_CONFIG=y

CONFIG_ZB_ENABLED=y
CONFIG_ZB_ZCZR=y
CONFIG_ZB_RADIO_NATIVE=y

CONFIG_FATFS_VOLUME_COUNT=2
CONFIG_FATFS_SECTORS_PER_CLUSTER_SDFAT=1

CONFIG_ESP_HTTP_SERVER_ENABLE=y

CONFIG_HTTPD_MAX_REQ_HDR_LEN=1024
CONFIG_HTTPD_MAX_URI_LEN=512

CONFIG_LWIP_MAX_SOCKETS=16

CONFIG_ESPTOOLPY_BAUD_921600B=y
```
